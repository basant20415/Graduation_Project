## Yocto-image/Gradution_rpi5/conf/bblayers.conf
```bitbake
# POKY_BBLAYERS_CONF_VERSION is increased each time build/conf/bblayers.conf
# changes incompatibly
POKY_BBLAYERS_CONF_VERSION = "2"

BBPATH = "${TOPDIR}"
BBFILES ?= ""

BBLAYERS ?= " \
  /home/ubuntu/EmbeddedLinux/YOCTO/poky/meta \
  /home/ubuntu/EmbeddedLinux/YOCTO/poky/meta-poky \
  /home/ubuntu/EmbeddedLinux/YOCTO/poky/meta-yocto-bsp \
  /home/ubuntu/EmbeddedLinux/YOCTO/poky/meta-raspberrypi \
  /home/ubuntu/EmbeddedLinux/YOCTO/poky/meta-grad-distro \
  /home/ubuntu/EmbeddedLinux/YOCTO/poky/meta-ai \
  /home/ubuntu/EmbeddedLinux/YOCTO/poky/meta-openembedded/meta-oe \
  /home/ubuntu/EmbeddedLinux/YOCTO/poky/meta-openembedded/meta-python \
  /home/ubuntu/EmbeddedLinux/YOCTO/poky/meta-openembedded/meta-networking \
  /home/ubuntu/EmbeddedLinux/YOCTO/poky/meta-features \
  /home/ubuntu/EmbeddedLinux/YOCTO/poky/meta-openembedded/meta-multimedia \
  /home/ubuntu/EmbeddedLinux/YOCTO/poky/meta-apps \
  /home/ubuntu/EmbeddedLinux/YOCTO/poky/meta-python2 \
  /home/ubuntu/EmbeddedLinux/YOCTO/poky/meta-freescale \
  "
```
